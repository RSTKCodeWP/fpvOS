## br-external/board/Config.in
```kconfig
config BR2_FPVOS_SOC_AR9311
	bool "Artosyn AR9311 SoC"
	depends on BR2_aarch64
	help
	  Enable packages for the AR9311 host controllers. Boards
	  still supply their wiring, firmware profiles and storage
	  policy.

config BR2_FPVOS_BOARD_ASCENT_VRX
	bool "Caddx Ascent VRX (Gnd485, AR9311)"
	depends on BR2_aarch64
	select BR2_FPVOS_SOC_AR9311
	help
	  Select Gnd485 board integration, including its NAND
	  partition parser. Other AR9311 boards can reuse
	  board/common/ar9311 without selecting this board's wiring,
	  stock firmware layout or update backend.
```

## br-external/package/air-busybox/Config.in
```kconfig
config BR2_PACKAGE_AIR_BUSYBOX
	bool "air-busybox"
	help
	  A DHCP server for the air unit's USB network (RNDIS): Buildroot's
	  busybox, statically linked, with udhcpd only, in the app volume
	  (/usrdata/fpv/air/bin/udhcpd). The stock busybox has none.
	  usb_ip.sh starts it once the USB link is switched to network.
```

## br-external/package/air-dropbear/Config.in
```kconfig
config BR2_PACKAGE_AIR_DROPBEAR
	bool "air-dropbear"
	depends on BR2_USE_MMU # fork()
	help
	  An SSH server for the air unit's app volume
	  (/usrdata/fpv/air/bin): Buildroot's dropbear, statically
	  linked. air/start.sh runs it when the image carries authorized
	  keys (FPVOS_AIR_SSH_KEYS at build time) or a root password
	  (FPVOS_AIR_ROOT_PASSWORD, root by default; empty for none).
```

## br-external/package/ar-libre/Config.in
```kconfig
config BR2_PACKAGE_AR_LIBRE
	bool "ar-libre"
	depends on BR2_LINUX_KERNEL
	depends on BR2_TOOLCHAIN_HAS_THREADS
	help
	  fpvOS's own host stack for the AR8030 radio, replacing Artosyn's
	  kernel driver, daemon and client library: arlink.ko uploads the
	  baseband firmware and gives /dev/arlink0, and
	  libar8030_client.so is the client API, in-process.

	  On the goggle (kestrel) they go into the root filesystem and
	  bb_only.sh brings the radio up without a daemon. On the air unit
	  (kestrel-air) both go into the air unit's app volume.

	  Reverse-engineered from stock devices; GPL-2.0+.

	  https://github.com/gehee/ar_libre

comment "ar-libre needs a Linux kernel and a toolchain with threads"
	depends on !BR2_LINUX_KERNEL || !BR2_TOOLCHAIN_HAS_THREADS
```

## br-external/package/ar9311-firmware/Config.in
```kconfig
config BR2_PACKAGE_AR9311_FIRMWARE
	bool "AR9311 Wave521C firmware"
	depends on BR2_aarch64
	help
	  Download pinned vendor firmware and extract chagall.bin
	  into the RAM filesystem using Buildroot host tools. Both
	  the download and extracted binary are hash-checked.
	  Redistribution rights are unverified; the binary is not
	  included in this repository.

if BR2_PACKAGE_AR9311_FIRMWARE

choice
	prompt "Validated codec firmware source"
	default BR2_PACKAGE_AR9311_FIRMWARE_ASCENT_17_5_15
	help
	  Boards select a validated source profile. Compatible boards
	  may share the same profile and cached download.

config BR2_PACKAGE_AR9311_FIRMWARE_ASCENT_17_5_15
	bool "Caddx Ascent VRX 17.5.15"
	help
	  Extract from Caddx's official Ascent_G_Gnd update image.
	  Its codec binary matches the validated 17.5.8 binary.

endchoice

endif
```

## br-external/package/ar9311-mmc/Config.in
```kconfig
config BR2_PACKAGE_AR9311_MMC
	bool "AR9311 MMC and GPIO platform drivers"
	depends on BR2_aarch64
	depends on BR2_LINUX_KERNEL
	help
	  Build the Artosyn MMC wrapper and Missing-Lynk GPIO controller
	  against this image's kernel. Requires CONFIG_MMC_DW,
	  CONFIG_MMC_DW_PLTFM, CONFIG_COMMON_CLK_AR9311_MMC and
	  CONFIG_GPIOLIB. Source clocks and gates use the kernel's
	  AR9311 clock provider; other SoC drivers are omitted.
```

## br-external/package/ar9311-radio/Config.in
```kconfig
config BR2_PACKAGE_AR9311_RADIO
	bool "AR9311 SDIO radio"
	depends on BR2_FPVOS_SOC_AR9311
	depends on BR2_LINUX_KERNEL
	depends on BR2_TOOLCHAIN_HAS_THREADS
	depends on BR2_HOSTARCH = "x86_64"
	select BR2_PACKAGE_AR9311_MMC
	select BR2_PACKAGE_AR_LIBRE
	select BR2_PACKAGE_OPEN8030
	help
	  AR8030 radio over the AR9311 SDIO host, using ar_libre and
	  Open8030. Select the board's Open8030 profile and radio
	  config, SDIO transport and ground/station role. Device tree
	  supplies the host wiring, power rails and reset GPIO.
	  Firmware loads into radio RAM; no flash writes.
```

## br-external/package/ar9311-recovery/Config.in
```kconfig
config BR2_PACKAGE_AR9311_RECOVERY
	bool "AR9311 built-in NAND recovery environment"
	depends on BR2_aarch64 && BR2_STATIC_LIBS
	depends on BR2_PACKAGE_FPVOS_UPDATE_AR9311
	select BR2_PACKAGE_DROPBEAR
	help
	  Build a small independent initramfs into the NAND kernel. It loads
	  and verifies the main fpvOS RAM root from NAND, or provides the USB
	  updater and SSH recovery service without an SD card.
```

## br-external/package/ascent-gnd485-recovery/Config.in
```kconfig
config BR2_PACKAGE_ASCENT_GND485_RECOVERY
	bool "Ascent Gnd485 built-in NAND recovery environment"
	depends on BR2_aarch64 && BR2_STATIC_LIBS
	depends on BR2_PACKAGE_FPVOS_UPDATE_ASCENT_GND485
	select BR2_PACKAGE_DROPBEAR
	help
	  Build a small independent initramfs into the NAND kernel. It loads
	  and verifies the main fpvOS RAM root from NAND, or provides the USB
	  updater and SSH recovery service without an SD card.
```

## br-external/package/ascent-vrx-recovery/Config.in
```kconfig
config BR2_PACKAGE_ASCENT_VRX_RECOVERY
	bool "Ascent VRX built-in NAND recovery environment"
	depends on BR2_aarch64 && BR2_STATIC_LIBS
	depends on BR2_PACKAGE_FPVOS_UPDATE_ASCENT_VRX
	select BR2_PACKAGE_DROPBEAR
	help
	  Build a small independent initramfs into the NAND kernel. It loads
	  and verifies the main fpvOS RAM root from NAND, or provides the USB
	  updater and SSH recovery service without an SD card.
```

## br-external/package/fpvos-update/Config.in
```kconfig
config BR2_PACKAGE_FPVOS_UPDATE
	bool "fpvOS firmware updater"
	depends on BR2_USE_MMU
	# Gnd485 is currently the only supplied hardware backend.
	depends on BR2_aarch64
	help
	  USB CDC transport, bundle verification and update service. Storage,
	  image validation and clean-mode policy come from a board backend.

if BR2_PACKAGE_FPVOS_UPDATE
choice
	prompt "Updater board backend"

config BR2_PACKAGE_FPVOS_UPDATE_ASCENT_VRX
	bool "Ascent VRX NAND (Gnd485, AR9311)"
	depends on BR2_FPVOS_BOARD_ASCENT_VRX
	help
	  Fixed NAND layout, readback and rollback, clean-mode selection and
	  original vendor kernel/DTB restoration for Gnd485.
endchoice
endif
```

## br-external/package/fpvos-vendor-libs/Config.in
```kconfig
config BR2_PACKAGE_FPVOS_VENDOR_LIBS
	bool "fpvos-vendor-libs"
	depends on BR2_PACKAGE_ROCKCHIP_MALI || BR2_PACKAGE_MESA3D
	help
	  Install the extracted vendor shared libraries (libmali for this
	  board's actual GPU, libar8030_client, librga) into staging and
	  target. Required to link kestrel. With Mesa providing EGL/GLES/GBM,
	  libmali is left out.

	  Populate them first with scripts/extract-vendor.py; they come from
	  firmware you own and are not redistributed by fpvOS.
```

## br-external/package/hi3516cv610-sdk/Config.in
```kconfig
config BR2_PACKAGE_HI3516CV610_SDK
	bool "hi3516cv610-sdk"
	depends on BR2_arm
	help
	  The userspace libraries kestrel-air runs with on the unit: the
	  Hi3516CV610 MPP V1.0.2.0 B051 MPI, ISP and ISP-algorithm
	  libraries, and the camera's sensor drivers (CV2004, OS02K10).
	  Prebuilt, in one archive pinned by commit and checked by hash.
```

## br-external/package/kestrel-air/Config.in
```kconfig
config BR2_PACKAGE_KESTREL_AIR
	bool "kestrel-air"
	depends on BR2_arm
	select BR2_PACKAGE_HI3516CV610_SDK
	select BR2_PACKAGE_AR_LIBRE
	help
	  kestrel-air: the fpvOS air-unit application for the Caddx
	  Ascent (camera, encoder, AR8030 radio through ar_libre). Its
	  sensor drivers come with hi3516cv610-sdk. Installed into
	  the app volume, /usrdata/fpv/air. GPL-3.0, with a permission
	  to combine it with the SDK's libraries.
```

## br-external/package/open8030-profiles/Config.in
```kconfig
config BR2_PACKAGE_OPEN8030_PROFILES
	bool "open8030-profiles"
	help
	  Open8030's board profiles for the Ascent Lite/Lite+ and the VRX
	  Pro (register defaults, pin records, frame-control-header keys,
	  flash parts), reverse engineered from Caddx's stock radio
	  firmware, and the goggle radio's Open8030 configuration: what
	  the open8030 package builds the radio firmware with. Nothing is
	  installed on the target.
```
